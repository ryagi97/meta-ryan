## meta-ryan-bbb/conf/layer.conf
```bitbake
# We have a conf and classes directory, add to BBPATH
BBPATH .= ":${LAYERDIR}"

# We have recipes-* directories, add to BBFILES
BBFILES += "${LAYERDIR}/recipes-*/*/*.bb \
            ${LAYERDIR}/recipes-*/*/*.bbappend"

BBFILE_COLLECTIONS += "meta-ryan-bbb"
BBFILE_PATTERN_meta-ryan-bbb = "^${LAYERDIR}/"
BBFILE_PRIORITY_meta-ryan-bbb = "11"

# This should only be incremented on significant changes that will
# cause compatibility issues with other layers
LAYERVERSION_skeleton = "1"

LAYERDEPENDS_meta-ryan-bbb = " \
    yocto \
    meta-ti-bsp \
"

LAYERSERIES_COMPAT_meta-ryan-bbb = "kirkstone"
```

## meta-ryan-bbb/conf/local.conf.sample
```bitbake
#
# Machine Selection
#
MACHINE ?= "beaglebone"

#
# Where to place downloads
#
DL_DIR ?= "/yocto-downloads"

#
# Where to place shared-state files
#
#SSTATE_DIR ?= "${TOPDIR}/sstate-cache"

#
# Where to place the build output
#
#TMPDIR = "${TOPDIR}/tmp"

#
# Default policy config
#
DISTRO ?= "poky"

#
# Package Management configuration
#
PACKAGE_CLASSES ?= "package_deb"

#
# SDK target architecture
#
#SDKMACHINE ?= "i686"

#
# Extra image configuration defaults
#
EXTRA_IMAGE_FEATURES ?= "debug-tweaks"

#
# Additional image features
#
USER_CLASSES ?= "buildstats"

#
# ROOTFS Image Modifications
#
IMAGE_FSTYPES += "wic"
IMAGE_FSTYPES:remove = "wic.xz wic.bmap"

#
# Runtime testing of images
#
#IMAGE_CLASSES += "testimage testsdk"
#TESTIMAGE_AUTO:qemuall = "1"

#
# Interactive shell configuration
#
#OE_TERMINAL = "auto"
# By default disable interactive patch resolution (tasks will just fail instead):
PATCHRESOLVE = "noop"

#
# Disk Space Monitoring during the build
#
BB_DISKMON_DIRS ??= "\
    STOPTASKS,${TMPDIR},1G,100K \
    STOPTASKS,${DL_DIR},1G,100K \
    STOPTASKS,${SSTATE_DIR},1G,100K \
    STOPTASKS,/tmp,100M,100K \
    HALT,${TMPDIR},100M,1K \
    HALT,${DL_DIR},100M,1K \
    HALT,${SSTATE_DIR},100M,1K \
    HALT,/tmp,10M,1K"

#
# Shared-state files from other locations
#
#SSTATE_MIRRORS ?= "\
#file://.* https://someserver.tld/share/sstate/PATH;downloadfilename=PATH \
#file://.* file:///some/local/dir/sstate/PATH"

#
# Yocto Project SState Mirror
#
#BB_HASHSERVE_UPSTREAM = "hashserv.yocto.io:8687"
#SSTATE_MIRRORS ?= "file://.* http://sstate.yoctoproject.org/all/PATH;downloadfilename=PATH"

#
# Qemu configuration
#
#ASSUME_PROVIDED += "libsdl2-native"

#
# Hash Equivalence
#
#BB_HASHSERVE = "auto"
#BB_SIGNATURE_HANDLER = "OEEquivHash"

#
# Memory Resident Bitbake
#
#BB_SERVER_TIMEOUT = "60"

# CONF_VERSION is increased each time build/conf/ changes incompatibly and is used to
# track the version of this file when it was generated. This can safely be ignored if
# this doesn't mean anything to you.
CONF_VERSION = "2"
```

## meta-ryan-bbb/conf/machine/beagleboneryan.conf
```bitbake
#@TYPE: Machine
#@NAME: Ryan's BeagleBone machine
#@DESCRIPTION: Machine configuration for Ryan's modded http://beagleboard.org/bone board

require conf/machine/beaglebone.conf

PREFERRED_PROVIDER_virtual/kernel = "linux-bb.org"
PREFERRED_PROVIDER_virtual/bootloader = "u-boot-ti-staging"
PREFERRED_PROVIDER_u-boot = "u-boot-ti-staging"

KERNEL_DEVICETREE:append = "am335x-boneblackryan.dtb"
```
